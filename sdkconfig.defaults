## sdkconfig.defaults
```kconfig
CONFIG_BOOTLOADER_COMPILER_OPTIMIZATION_PERF=y

CONFIG_ESPTOOLPY_FLASHMODE_QIO=y
CONFIG_ESPTOOLPY_FLASHSIZE_8MB=y
CONFIG_ESPTOOLPY_FLASHSIZE="8MB"

CONFIG_PARTITION_TABLE_CUSTOM=y
CONFIG_PARTITION_TABLE_FILENAME="partitions.csv"

CONFIG_COMPILER_OPTIMIZATION_PERF=y

CONFIG_SPIRAM=y
CONFIG_SPIRAM_MODE_OCT=y
CONFIG_SPIRAM_FETCH_INSTRUCTIONS=y
CONFIG_SPIRAM_RODATA=y
CONFIG_SPIRAM_SPEED_80M=y
CONFIG_SPIRAM_SPEED=80

CONFIG_ESP_DEFAULT_CPU_FREQ_MHZ_240=y
CONFIG_ESP_DEFAULT_CPU_FREQ_MHZ=240

CONFIG_ESP_SYSTEM_PANIC_REBOOT_DELAY_SECONDS=15

CONFIG_ESP_TASK_WDT_EN=n
CONFIG_FREERTOS_HZ=1000

CONFIG_FLASHMODE_QIO=y




CONFIG_ESP_CONSOLE_UART_DEFAULT=n
# Enable USB CDC console
CONFIG_ESP_CONSOLE_USB_CDC=y

# Enable TinyUSB stack (required for CDC on ESP32-S3)
CONFIG_TINYUSB_ENABLED=y
CONFIG_TINYUSB_CDC_ENABLED=y
# CONFIG_BOOTLOADER_CUSTOM_HOOKS=y

# Enable ESP32-S3 OTG as device
CONFIG_ESP32S3_USB_OTG_SUPPORTED=y
CONFIG_ESP32S3_USB_OTG_DEVICE_SUPPORT=y
CONFIG_ESP_USB_OTG_ENABLED=y

# Optional: reduce logging or debug prints to keep USB stable
CONFIG_TINYUSB_DEBUG_LEVEL=5
```
